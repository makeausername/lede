// SPDX-License-Identifier: GPL-2.0-or-later OR MIT
#include "mt7986a-netcore-n60-pro.dts"

/ {
	model = "Netcore N60 Pro (HKC stock slot 1 candidate)";
	compatible = "netcore,n60-pro-stock-slot1", "mediatek,mt7986a";
};
